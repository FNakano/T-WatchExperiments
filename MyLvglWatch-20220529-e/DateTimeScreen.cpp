#include "DateTimeScreen.h"
#include "ExampleScreen.h"

/* after buildWatchFace() execution, is a pointer 
 * to the LVGL label that displays time. 
 * file scope variables.
 * Did not work. Function updateScreenData2() can access dateLabel and battLabel.
 * Renamed ExampleScreen.ino to ExampleScreen.cpp. As expected, got
 * 'dateLabel' was not declared in this scope
 * got type not defined errors which were overcome including headers. 
 */
static lv_obj_t *timeLabel = NULL;  // label to show time
static lv_obj_t *dateLabel = NULL;  // label to show date
static lv_obj_t *battLabel = NULL;  // label to show batt
static lv_obj_t *toggleLabel = NULL;  // label of toggle button

void updateScreenData () {
    TTGOClass *ttgo = TTGOClass::getWatch();    // pointer to watch internals
    PCF8563_Class *rtc = ttgo->rtc;             // pointer to RTC (real-time clock) 

    lv_label_set_text(timeLabel, rtc->formatDateTime(PCF_TIMEFORMAT_HM));  // display time without seconds
    lv_label_set_text(dateLabel, rtc->formatDateTime(PCF_TIMEFORMAT_YYYY_MM_DD));  // display date
    int battLevel = ttgo->power->getBattPercentage();
    lv_label_set_text_fmt(battLabel, "%3d%s", battLevel,"%");  // display battery level.
    lv_label_set_text_fmt(toggleLabel, "%d", ttgo->bl->getLevel());                 // set button 2 label text.
}

static void event_handler(lv_obj_t *obj, lv_event_t event)
/*
 * Handles touch (click) events generated by LVGL objects. 
 * This is a callback function. It is registered when the object (buttons and so) are created.
 * Hardware button is configured in setup and loop functions
 * LVGL Button sends only one LV_EVENT_CLICKED. 
 * LVGL Toggle sends one LV_EVENT_VALUE_CHANGED followed by one LV_EVENT_CLICKED
*/
{
    if (event == LV_EVENT_CLICKED) {
        //updateScreenData();
        buildWatchFace2();
        updateScreenData2();
        Serial.printf("Clicked\n"); 
    } else if (event == LV_EVENT_VALUE_CHANGED) {
        Serial.printf("Toggled\n");
    }
}

void toggle_event_handler(lv_obj_t *obj, lv_event_t event)
{
    TTGOClass *ttgo = TTGOClass::getWatch();    // pointer to watch internals
    PCF8563_Class *rtc = ttgo->rtc;             // pointer to RTC (real-time clock) 

    if (event == LV_EVENT_CLICKED) {
        uint8_t curLev=ttgo->bl->getLevel();
        curLev=(curLev>206)?255:curLev+50;
        ttgo->bl->adjust(curLev);
        updateScreenData();
        Serial.printf("Clicked\n"); 
    }
}
  

LV_FONT_DECLARE(liquidCrystal_nor_64);
LV_FONT_DECLARE(lv_font_montserrat_14);
LV_FONT_DECLARE(lv_font_montserrat_28);

void buildWatchFace () {
/*
 * Build a watch face (a screen) containing one button,
 * one label and one toggle.
 * Click on the button to display current time in the label.
 * Click on the toggle to change its state (color).
 * Events are also logged in the serial monitor.
 * Shows how to create and load screen and container objects
 * Gets current screen and modify it, for performance.
 * This might put objects over the previous screen objects.
 * Also objects are not destroyed. this may fill dynamic memory 
 * with unused object.
 */
 
    static lv_style_t opaqueBackgroundStyle;
    /* styles do not set sizes. */

    lv_style_set_border_color(&opaqueBackgroundStyle, LV_OBJ_PART_MAIN, LV_COLOR_BLACK);
    lv_style_set_border_opa(&opaqueBackgroundStyle, LV_OBJ_PART_MAIN, LV_OPA_100); // opaque
    lv_style_set_bg_color(&opaqueBackgroundStyle, LV_OBJ_PART_MAIN, LV_COLOR_BLACK);
    lv_style_set_bg_opa(&opaqueBackgroundStyle, LV_OBJ_PART_MAIN, LV_OPA_100); // opaque

    lv_obj_t *cont = lv_scr_act();
    lv_obj_add_style(cont, LV_OBJ_PART_MAIN, &opaqueBackgroundStyle);  // apply style

    /*
     * timeStyle is the style of the background container and the label to display time.
     */
    static lv_style_t timeStyle;
    /* styles do not set sizes. */
    //lv_style_set_size(&timeStyle, 240, 240);

    lv_style_set_border_color(&timeStyle, LV_OBJ_PART_MAIN, LV_COLOR_BLACK);
    lv_style_set_border_opa(&timeStyle, LV_OBJ_PART_MAIN, LV_OPA_100); // opaque
    lv_style_set_bg_color(&timeStyle, LV_OBJ_PART_MAIN, LV_COLOR_BLACK);
    // lv_style_set_bg_opa(&timeStyle, LV_OBJ_PART_MAIN, LV_OPA_0); // transparent
    lv_style_set_bg_opa(&timeStyle, LV_OBJ_PART_MAIN, LV_OPA_100); // opaque
    lv_style_set_text_color(&timeStyle, LV_OBJ_PART_MAIN, LV_COLOR_WHITE);
    lv_style_set_text_font(&timeStyle, LV_STATE_DEFAULT, &liquidCrystal_nor_64); // ugly
        
    /**/
    timeLabel = lv_label_create(cont, NULL);
    lv_obj_add_style(timeLabel, LV_OBJ_PART_MAIN, &timeStyle);  // apply style
    lv_label_set_long_mode(timeLabel, LV_LABEL_LONG_CROP);
    lv_obj_set_width(timeLabel, 240);
    lv_label_set_align(timeLabel, LV_LABEL_ALIGN_CENTER);
    lv_label_set_text(timeLabel, "T-Watch");
    lv_obj_align(timeLabel, NULL, LV_ALIGN_CENTER, 0, 0);


    lv_obj_t *label;  // label - auxiliary pointer to some button's label.

    static lv_style_t buttonStyle;
    lv_style_set_bg_color(&buttonStyle, LV_OBJ_PART_MAIN, LV_COLOR_BLACK);
    // lv_style_set_bg_opa(&buttonStyle, LV_OBJ_PART_MAIN, LV_OPA_0); // transparent
    lv_style_set_bg_opa(&buttonStyle, LV_OBJ_PART_MAIN, LV_OPA_100); // opaque
    lv_style_set_text_color(&buttonStyle, LV_OBJ_PART_MAIN, LV_COLOR_WHITE);
    lv_style_set_text_font(&buttonStyle, LV_STATE_DEFAULT, &lv_font_montserrat_14);

  // button 1
    lv_obj_t *btn1 = lv_btn_create(cont, NULL);  // create button 1. Its parent is the container
    lv_obj_set_event_cb(btn1, event_handler);            // button 1 event handler
    lv_obj_align(btn1, NULL, LV_ALIGN_CENTER, 0, -50);   // button 1 text alignment

    lv_obj_add_style(btn1, LV_OBJ_PART_MAIN, &buttonStyle);  // apply style
    label = lv_label_create(btn1, NULL);                 // create a label inside button 1 and get a pointer to it.
    lv_label_set_text(label, "Button");                  // set button 1 label text

  // button 2 (checkbutton)
    lv_obj_t *btn2 = lv_btn_create(cont, NULL);
    lv_obj_set_event_cb(btn2, toggle_event_handler);            // shares button 1 same event handler 
    lv_obj_align(btn2, NULL, LV_ALIGN_CENTER, 0, 50);
    lv_btn_set_checkable(btn2, true);                    // button 2 is a checkbutton
    lv_btn_toggle(btn2);                                 // set button 2 to be a toggle button: https://docs.lvgl.io/latest/en/html/widgets/btn.html#checkable
                                                         // I suppose button color change is managed transparently
    lv_btn_set_fit2(btn2, LV_FIT_NONE, LV_FIT_TIGHT);

    lv_obj_add_style(btn2, LV_OBJ_PART_MAIN, &buttonStyle);  // apply style
    toggleLabel = lv_label_create(btn2, NULL);                 // create a label inside button 2 and get a pointer to it.
    lv_label_set_text(toggleLabel, "Toggled");                 // set button 2 label text.

    /**/
    static lv_style_t infoStyle;
    lv_style_set_bg_color(&infoStyle, LV_OBJ_PART_MAIN, LV_COLOR_BLACK);
    lv_style_set_bg_opa(&infoStyle, LV_OBJ_PART_MAIN, LV_OPA_100); // opaque
    lv_style_set_text_color(&infoStyle, LV_OBJ_PART_MAIN, LV_COLOR_WHITE);
    lv_style_set_text_font(&infoStyle, LV_STATE_DEFAULT, &lv_font_montserrat_28);

    dateLabel = lv_label_create(cont, NULL);
    lv_obj_add_style(dateLabel, LV_OBJ_PART_MAIN, &infoStyle);  // apply style
    lv_label_set_text(dateLabel, "T-Watch");
    lv_obj_align(dateLabel, NULL, LV_ALIGN_IN_TOP_LEFT, 0, 0);

    /**/
    battLabel = lv_label_create(cont, NULL);
    lv_obj_add_style(battLabel, LV_OBJ_PART_MAIN, &infoStyle);  // apply style
    lv_label_set_text(battLabel, "T-Watch");
    lv_obj_align(battLabel, NULL, LV_ALIGN_IN_TOP_LEFT, 170, 0);
}
